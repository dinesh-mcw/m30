## meta-lumotive/conf/layer.conf
```bitbake
# We have a conf and classes directory, add to BBPATH
BBPATH .= ":${LAYERDIR}"

# We have recipes-* directories, add to BBFILES
BBFILES += "${LAYERDIR}/recipes-*/*/*.bb \
            ${LAYERDIR}/recipes-*/*/*.bbappend"

BBFILE_COLLECTIONS += "meta-lumotive"
BBFILE_PATTERN_meta-lumotive = "^${LAYERDIR}/"
BBFILE_PRIORITY_meta-lumotive = "16"

LAYERDEPENDS_meta-lumotive = "core"
LAYERSERIES_COMPAT_meta-lumotive = "kirkstone"
```
